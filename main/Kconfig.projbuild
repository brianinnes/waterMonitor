## main/Kconfig.projbuild
```kconfig
menu "WaterFlow meter"

config ESP_WIFI_SSID
    string "WiFi SSID"
    default "myssid"
    help
	SSID (network name) to connect to.

config ESP_WIFI_PASSWORD
    string "WiFi Password"
    default "mypassword"
    help
	WiFi password (WPA or WPA2) to use.

config ESP_MQTT_CLIENTID
    string "Unique client ID for this device"
    default "Mon01"
    help
    Unique ID for this ESP32 device (no spaces or special characters)

config ESP_MQTT_BROKER_URI
    string "MQTT Broker URI"
    default "mqtts://waterMonitor.local:8883"
    help
    format mqtts://<broker host name>:<broker port>

config ESP_MQTT_BROKER_USERNAME
    string "MQTT Broker username"
    default "mosquitto"
    help
    Username to log onto broker

config ESP_MQTT_BROKER_USERPWD
    string "MQTT Broker user password"
    default "passw0rd"
    help
    User password for broker
endmenu
```
